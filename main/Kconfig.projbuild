## main/Kconfig.projbuild
```kconfig
menu "BookBook"
    # Pins and parts of Phil's VA board (a Seeed XIAO ESP32-S3); see docs/hardware.md.

    config BOOKBOOK_LED_COUNT
        int "Number of WS2812 LEDs on GPIO2"
        default 12

    config BOOKBOOK_I2S_BCLK
        int "MAX98357A BCLK GPIO"
        default 7
    config BOOKBOOK_I2S_LRC
        int "MAX98357A LRC/WS GPIO"
        default 44
    config BOOKBOOK_I2S_DIN
        int "MAX98357A DIN GPIO"
        default 8
    config BOOKBOOK_I2S_SD_MODE
        int "MAX98357A SD_MODE GPIO"
        default 9
    config BOOKBOOK_MIC_CLK
        int "PDM microphone CLK GPIO"
        default 1
    config BOOKBOOK_MIC_DAT
        int "PDM microphone DAT GPIO"
        default 3
    config BOOKBOOK_MIC_RIGHT_SLOT
        bool "Microphone SEL is tied to 3V3 (right slot); off = SEL tied to GND (left slot)"
        default n
    config BOOKBOOK_MIC_GAIN
        int "Microphone software gain (multiplier), used when adaptive gain is off"
        range 1 32
        default 4
    config BOOKBOOK_MIC_AUTO_GAIN
        bool "Adaptive microphone gain: scale each recording to a target level"
        default y
        help
            After a recording, the level of its loud parts (the 99.5th percentile, so a click or bump does not
            count) is measured and one gain is applied to the whole recording to bring that level to the
            target. Quiet or distant speech is raised and loud or close speech is not pushed into clipping.
    config BOOKBOOK_MIC_TARGET_PEAK
        int "Adaptive gain: level the loud parts of a recording are scaled to (of 32767)"
        range 2000 30000
        default 12000
        depends on BOOKBOOK_MIC_AUTO_GAIN
    config BOOKBOOK_MIC_MAX_GAIN
        int "Adaptive gain: largest multiplier (limits how much room noise is amplified)"
        range 1 64
        default 20
        depends on BOOKBOOK_MIC_AUTO_GAIN

    config BOOKBOOK_TOUCH_ENABLED
        bool "Use the capacitive touch pad as the button (off: the BOOT button is the button)"
        default y
        help
            Turn this off to run without the touch sensor at all (for example to rule it out while
            debugging); the BOOT button (GPIO0) then becomes the button.
    config BOOKBOOK_TOUCH_PIN
        int "Capacitive touch pad GPIO, used as the button"
        default 6
        help
            Same pad as PhilbotSays: GPIO6 (XIAO D5). Must be a touch-capable pin (GPIO1-14 on the
            ESP32-S3; the number equals the touch channel).
    config BOOKBOOK_TOUCH_ALSO_BOOT_BUTTON
        bool "Also treat the BOOT button (GPIO0) as the button (bench fallback)"
        default n
        help
            ORs the BOOT button in with the touch pad, like PhilbotSays' dev button. Off by default:
            the touch pad is the button. Never hold BOOT while powering up or resetting.

    config BOOKBOOK_ANTHROPIC_KEY
        string "Anthropic API key (baked in)"
        default ""
    config BOOKBOOK_MEMORY_URL
        string "Memory storage container SAS URL (baked in)"
        default ""
    config BOOKBOOK_PRACTICE_MODE
        bool "Practice mode: pretend to add and remove books, change nothing on the real account"
        default y
    config BOOKBOOK_VA_USER
        string "Library login: email or VA id (default; editable on the setup page)"
        default ""
    config BOOKBOOK_VA_PASSWORD
        string "Library password (default; editable on the setup page)"
        default ""

    config BOOKBOOK_CLAUDE_MODEL
        string "Claude model id"
        default "claude-sonnet-5"

    config BOOKBOOK_SPEAKER_VOLUME
        int "Software volume, percent of full scale"
        range 1 100
        default 80

    config BOOKBOOK_ADMIN_PASSWORD
        string "Factory default password for the setup page (user name: admin)"
        default "bookbook"
        help
            Baked into the firmware: the setup page cannot change it. Override it in the git-ignored
            secrets/sdkconfig.secrets rather than committing a real value.

    config BOOKBOOK_SETUP_AP_PASSWORD
        string "Password of the Librarian-XXXX setup Wi-Fi network (8-63 characters)"
        default "bookbook1"
        help
            Anyone who knows this can join the setup network. Override it in the git-ignored
            secrets/sdkconfig.secrets rather than committing a real value.

    config BOOKBOOK_WIFI_SSID
        string "Wi-Fi SSID (default; editable on the setup page)"
        default ""
    config BOOKBOOK_WIFI_PASSWORD
        string "Wi-Fi password (default; editable on the setup page)"
        default ""
    config BOOKBOOK_AZURE_SPEECH_KEY
        string "Azure Speech key (baked in)"
        default ""
    config BOOKBOOK_AZURE_SPEECH_REGION
        string "Azure Speech region (baked in)"
        default "eastus"
endmenu
```
